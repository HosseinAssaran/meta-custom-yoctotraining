## conf/layer.conf
```bitbake
# We have a conf and classes directory, add to BBPATH
BBPATH .= ":${LAYERDIR}"

# We have recipes-* directories, add to BBFILES
BBFILES += "${LAYERDIR}/recipes-*/*/*.bb \
            ${LAYERDIR}/recipes-*/*/*.bbappend"

BBFILE_COLLECTIONS += "meta-custom"
BBFILE_PATTERN_meta-custom = "^${LAYERDIR}/"
BBFILE_PRIORITY_meta-custom = "7"

LAYERDEPENDS_meta-custom = "core"
LAYERSERIES_COMPAT_meta-custom = "kirkstone"

KERNEL_DEVICETREE:append:beaglebone-yocto = " am335x-boneblue.dtb"
PREFERRED_VERSION_linux-yocto:beaglebone-yocto = "5.10%"
WKS_FILE:beaglebone-yocto = "nfs-beaglebone-yocto.wks"
```
